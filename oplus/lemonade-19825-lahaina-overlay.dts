/dts-v1/;
/plugin/;

#include "lahaina-mtp-lemonade.dtsi"
#include "lahaina_overlay_oplus_common.dtsi"
#include "lahaina_overlay_oplus_common_pinctrl.dtsi"
#include "lemonade_common.dtsi"
#include "lemonade-19825.dtsi"
/ {
    model = "Qualcomm Technologies, Inc. Lahaina MTP lemonade";
    compatible = "qcom,lahaina-mtp", "qcom,lahaina", "qcom,mtp";
    qcom,board-id = <0x10008 0>;
    /*we can add project id to this array,uefi can auto read it,if new project,we add to this array */
    oplus,dtsi_no = <19825>;
    oem,project-id = <0x19825>; /*8350 use hex*/
    oem,project-codename = "lemonade";
    /*we can add hw id to this array,uefi can auto read it,if new hw,we add to this array  */
    oem,hw-id = <11 12 13 21 22 23 31 32 33>;
};
